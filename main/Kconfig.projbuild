## main/Kconfig.projbuild
```kconfig
menu "MicroPaw"

config MICROPAW_TELEGRAM
    bool "Telegram channel"
    default y

config MICROPAW_WEB_SEARCH
    bool "DuckDuckGo Lite search"
    default y

config MICROPAW_WEB_FETCH
    bool "Bounded result-page fetch"
    depends on MICROPAW_WEB_SEARCH
    default y

config MICROPAW_WIKIPEDIA
    bool "Wikipedia search source"
    depends on MICROPAW_WEB_SEARCH
    default y

config MICROPAW_ARXIV
    bool "arXiv search source"
    depends on MICROPAW_WEB_SEARCH
    default y

config MICROPAW_RSS
    bool "RSS and Atom reader"
    default y

config MICROPAW_GMAIL
    bool "Gmail tools"
    default y

config MICROPAW_CALENDAR
    bool "Google Calendar tools"
    default y

config MICROPAW_LLM_MODEL
    string "Default LLM model"
    default "gpt-5.6-luna"

config MICROPAW_WORK_TEXT_BYTES
    int "Large text capacity in PSRAM"
    range 32768 262144
    default 131072

config MICROPAW_LLM_MAX_OUTPUT_TOKENS
    int "Maximum inference output tokens"
    range 1024 65536
    default 32768

config MICROPAW_LLM_STREAM_LIMIT
    int "Inference stream byte limit"
    range 131072 16777216
    default 4194304

config MICROPAW_AGENT_STACK
    int "Agent task stack bytes"
    range 8192 32768
    default 16384

config MICROPAW_TELEGRAM_STACK
    int "Telegram task stack bytes"
    range 4096 16384
    default 12288

config MICROPAW_TELEGRAM_SENDER_STACK
    int "Telegram sender task stack bytes"
    range 4096 16384
    default 12288

config MICROPAW_SCHEDULER_STACK
    int "Scheduler task stack bytes"
    range 3072 8192
    default 4096

config MICROPAW_CLI_STACK
    int "Serial console task stack bytes"
    range 3072 8192
    default 5120

config MICROPAW_SEARCH_DOWNLOAD_LIMIT
    int "Search response byte limit"
    range 16384 98304
    default 49152

config MICROPAW_PAGE_DOWNLOAD_LIMIT
    int "Fetched page byte limit"
    range 8192 524288
    default 131072

endmenu
```

## sdkconfig.defaults
```kconfig
CONFIG_IDF_TARGET="esp32s3"
CONFIG_COMPILER_OPTIMIZATION_PERF=y
CONFIG_BOOTLOADER_COMPILER_OPTIMIZATION_PERF=y
CONFIG_NEWLIB_NANO_FORMAT=y
CONFIG_PARTITION_TABLE_CUSTOM=y
CONFIG_PARTITION_TABLE_CUSTOM_FILENAME="partitions.csv"
CONFIG_ESPTOOLPY_FLASHSIZE_16MB=y
CONFIG_ESPTOOLPY_FLASHSIZE="16MB"
CONFIG_ESPTOOLPY_FLASHMODE_DIO=y
CONFIG_ESPTOOLPY_FLASHMODE="dio"
CONFIG_ESPTOOLPY_FLASHFREQ_80M=y
CONFIG_SPIRAM=y
CONFIG_SPIRAM_MODE_OCT=y
CONFIG_SPIRAM_SPEED_80M=y
CONFIG_SPIRAM_ALLOW_BSS_SEG_EXTERNAL_MEMORY=y
CONFIG_SPIRAM_USE_MALLOC=y
CONFIG_SPIRAM_MALLOC_ALWAYSINTERNAL=4096
CONFIG_ESP_CONSOLE_USB_SERIAL_JTAG=y
CONFIG_ESP_CONSOLE_SECONDARY_NONE=y
CONFIG_ESP_MAIN_TASK_STACK_SIZE=4096
CONFIG_ESP_DEFAULT_CPU_FREQ_MHZ_240=y
CONFIG_ESP_DEFAULT_CPU_FREQ_MHZ=240
CONFIG_FREERTOS_HZ=1000
CONFIG_MBEDTLS_CERTIFICATE_BUNDLE=y
CONFIG_MBEDTLS_CERTIFICATE_BUNDLE_DEFAULT_CMN=y
CONFIG_MBEDTLS_CERTIFICATE_BUNDLE_CROSS_SIGNED_VERIFY=y
CONFIG_MBEDTLS_TLS_CLIENT_ONLY=y
CONFIG_ESP_HTTP_CLIENT_ENABLE_HTTPS=y
CONFIG_ESP_TLS_CLIENT_SESSION_TICKETS=y
CONFIG_ESP_WIFI_STATIC_RX_BUFFER_NUM=10
CONFIG_ESP_WIFI_DYNAMIC_RX_BUFFER_NUM=32
CONFIG_ESP_WIFI_STATIC_TX_BUFFER=y
CONFIG_ESP_WIFI_STATIC_TX_BUFFER_NUM=16
CONFIG_LWIP_TCP_SND_BUF_DEFAULT=32768
CONFIG_LWIP_TCP_WND_DEFAULT=32768
CONFIG_LWIP_TCP_RECVMBOX_SIZE=25
CONFIG_LOG_DEFAULT_LEVEL_INFO=y
CONFIG_LOG_MAXIMUM_LEVEL_INFO=y
CONFIG_ESP_TASK_WDT_TIMEOUT_S=30
CONFIG_MICROPAW_WORK_TEXT_BYTES=131072
CONFIG_MICROPAW_LLM_MAX_OUTPUT_TOKENS=32768
CONFIG_MICROPAW_LLM_STREAM_LIMIT=4194304
CONFIG_MICROPAW_PAGE_DOWNLOAD_LIMIT=131072
CONFIG_BOOTLOADER_APP_ROLLBACK_ENABLE=y
CONFIG_SECURE_SIGNED_APPS_NO_SECURE_BOOT=y
CONFIG_SECURE_SIGNED_ON_UPDATE_NO_SECURE_BOOT=y
CONFIG_SECURE_SIGNED_APPS_RSA_SCHEME=y
CONFIG_SECURE_BOOT_BUILD_SIGNED_BINARIES=y
CONFIG_SECURE_BOOT_SIGNING_KEY="secrets/micropaw_signing_key.pem"
```

## test_apps/agent/sdkconfig.defaults
```kconfig
CONFIG_PARTITION_TABLE_CUSTOM_FILENAME="../../partitions.csv"
CONFIG_SECURE_BOOT_SIGNING_KEY="../../secrets/micropaw_signing_key.pem"
```
